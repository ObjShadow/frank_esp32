## main/Kconfig.projbuild
```kconfig
menu "Firefly Chatbot Configuration"
    config SERVER_API_URL
        string "WebSocket API URL"
        default ""
        help
            Specifies which server will this device communicate with.

    config BUILD_CELLULAR
        bool "Build ML307R support"
        default n
        help
            Enable cellular network support via ML307R (DO NOT ENABLE, WIP)

    choice DEFAULT_NETWORK_IMPL
        prompt "Default network implementation"
        default NETWORK_IMPL_WIFI

        config NETWORK_IMPL_WIFI
            bool "Wi-Fi"

        config NETWORK_IMPL_CELLULAR
            bool "Cellular"
            depends on BUILD_CELLULAR
    endchoice

    config APP_LOG_TAG
        string "Default application log tag"
        default "App"

    config OWNER_NAME
        string "Name of the owner of this device"
        default ""

    config DEFAULT_TASK_STACK_SIZE
        int "Default stack depth of tasks"
        default 10240

endmenu
```
